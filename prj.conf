## CMakeLists.txt
```
cmake_minimum_required(VERSION 3.13.1)
find_package(Zephyr REQUIRED HINTS $ENV{ZEPHYR_BASE})
project(zephyr_motor_controller)

target_sources(app PRIVATE src/main.c)
target_sources(app PRIVATE src/motor_control_pipeline.c)
target_sources(app PRIVATE src/adrc_control_law.c)
target_sources(app PRIVATE src/pid_control_law.c)
target_sources(app PRIVATE src/lqr_siso_control_law.c)
target_sources(app PRIVATE src/motor_hardware_mf4005.c)
```

## prj.conf
```kconfig
CONFIG_PRINTK=y
CONFIG_SERIAL=y
CONFIG_CBPRINTF_FP_SUPPORT=y

CONFIG_SHELL=y
CONFIG_SHELL_HISTORY=y
CONFIG_SHELL_VT100_COLORS=y
CONFIG_CAN=y
CONFIG_COUNTER=y
CONFIG_COUNTER_SHELL=y

CONFIG_SYSTEM_WORKQUEUE_STACK_SIZE=8192
CONFIG_SYSTEM_WORKQUEUE_PRIORITY=-4
```

## boards/nucleo_g474re.overlay
```dts
&fdcan1 {
	bus-speed = <1000000>;
	status = "okay";
};

&timers2 {
	st,prescaler = <1>;
	status = "okay";

	counter {
		status = "okay";
	};
};
```

## src/main.c
```c
#include <zephyr/kernel.h>
#include <zephyr/device.h>
#include <zephyr/shell/shell.h>
#include <stdlib.h>

#include "control_law.h"
#include "adrc_control_law.h"
#include "pid_control_law.h"

#include "motor_hardware.h"
#include "motor_hardware_mf4005.h"
#include "motor_control_pipeline.h"

static const struct device * motor_can_port = DEVICE_DT_GET(DT_NODELABEL(fdcan1));
static struct motor_hardware_mf4005 motor_1;
static struct motor_control_pipeline control_1;
static struct adrc_control_law motor_adrc_1;
static struct pid_control_law motor_pid_1;

int main(void)
{
	pid_control_law_tune(&motor_pid_1, 1.0f, 0.0f, 0.0f, 36000);
	adrc_control_law_tune(&motor_adrc_1, 0.0005f, 300.0f, 1.0f, 10.0f, 0.001f);
	motor_hardware_mf4005_init(&motor_1, motor_can_port);
	motor_control_pipeline_add_hw(&control_1, motor_hardware_mf4005_get_if(&motor_1));
	motor_control_pipeline_add_control(&control_1, get_adrc_control_law_interface(&motor_adrc_1));
	motor_control_pipeline_register(&control_1, 1);
	motor_control_pipeline_set_position(&control_1, 90);

	return 0;
}

static int motor_set_ref(const struct shell *shell, size_t argc, char **argv)
{
	if (argc != 2) {
		return -EINVAL;
	}

	return motor_control_pipeline_set_position(&control_1, (strtof(argv[1], NULL)));
}

static int motor_gen_ramp(const struct shell *shell, size_t argc, char **argv)
{
	if (argc != 3) {
		return -EINVAL;
	}

	float start = strtof(argv[1], NULL);
	float end = strtof(argv[2], NULL);
	float current = start;
	float steps = (end - start) / 16.0f;

	for(; current < end; current += steps) {
		motor_control_pipeline_set_position(&control_1, current);
		k_sleep(K_MSEC(250));
	}

	return 0;

}


static int motor_change_control(const struct shell *shell, size_t argc, char **argv)
{
	if (argc != 2) {
		return -EINVAL;
	}

	long option = strtol(argv[1], NULL, 10);

	if(!option) {
		motor_control_pipeline_add_control(&control_1, get_pid_control_law_interface(&motor_pid_1));
	} else {
		motor_control_pipeline_add_control(&control_1, get_adrc_control_law_interface(&motor_adrc_1));
	}

	return 0;
}

static int motor_set_gains_pid(const struct shell *shell, size_t argc, char **argv)
{
	if (argc != 5) {
		return -EINVAL;
	}

	pid_control_law_tune(&motor_pid_1,
						(strtof(argv[1], NULL)),
						(strtof(argv[2], NULL)),
						(strtof(argv[3], NULL)),
						(strtof(argv[4], NULL)));

	return 0;

}

static int motor_set_gains_adrc(const struct shell *shell, size_t argc, char **argv)
{
	if (argc != 6) {
		return -EINVAL;
	}

	adrc_control_law_tune(&motor_adrc_1,
						(strtof(argv[1], NULL)),
						(strtof(argv[2], NULL)),
						(strtof(argv[3], NULL)),
						(strtof(argv[4], NULL)),
						(strtof(argv[5], NULL)));

	return 0;
}

static int motor_set_power(const struct shell *shell, size_t argc, char **argv)
{
	if (argc != 2) {
		return -EINVAL;
	}

	struct motor_hardware_if *m = motor_hardware_mf4005_get_if(&motor_1);
	return motor_hardware_set_current(m, (strtof(argv[1], NULL)));
}

SHELL_STATIC_SUBCMD_SET_CREATE(
	motor_control,
	SHELL_CMD(generate_test_ramp, NULL, "Generate an up and down ramp of 5 seconds", motor_gen_ramp),
	SHELL_CMD(set_reference, NULL, "Set velocity reference in RPM", motor_set_ref),
	SHELL_CMD(change_control_algo, NULL, "0 - PID, 1 - ADRC", motor_change_control),
	SHELL_CMD(set_gains_pid, NULL, "Set velocity PID KP and KI", motor_set_gains_pid),
	SHELL_CMD(set_gains_adrc, NULL, "Set velocity ADRC Gains", motor_set_gains_adrc),
	SHELL_CMD(motor_set_torque, NULL, "Set motor power in openloop", motor_set_power),
	SHELL_SUBCMD_SET_END
	);

SHELL_CMD_REGISTER(zephyr_motor_control, &motor_control, "Zephyr RTOS Motor control commands", NULL);
```

## src/adrc_control_law.c
```c
#include "adrc_control_law.h"

static int reset (struct siso_control_law * self)
{
    struct adrc_control_law *al =
        CL_CONTAINER_OF(self, struct adrc_control_law, interface);

    al->interface.reference = 0.0f;
    al->interface.measurement = 0.0f;
    al->zhat[0] = 0.0f;
    al->zhat[1] = 0.0f;
    al->zhat[2] = 0.0f;
    al->u_prev = 0.0f;

    return 0;
}

static int set (struct siso_control_law * self, float reference, float measurement)
{
    struct adrc_control_law *al =
        CL_CONTAINER_OF(self, struct adrc_control_law, interface);

    al->interface.reference = reference;
    al->interface.measurement = measurement;

    return 0;
}

static int update (struct siso_control_law * self, float dt, float *command)
{
    struct adrc_control_law *al =
        CL_CONTAINER_OF(self, struct adrc_control_law, interface);

    if(!command)
        return -EINVAL;

    float ref = al->interface.reference;
    float mes = al->interface.measurement;
    float zhat_1 = al->zhat[0];
    float zhat_2 = al->zhat[1];
    float zhat_3 = al->zhat[2];
    float l1 = al->l[0];
    float l2 = al->l[1];
    float l3 = al->l[2];
    float kp = al->kp;
    float kd = al->kd;
    float b0 = al->b0;
    float u_prev = al->u_prev;

    //First do the observer dynamics:
    float zhat_dot_1 = -l1 * zhat_1 + zhat_2 + l1 * mes;
    float zhat_dot_2 = -l2 * zhat_1 + zhat_3 + l2 * mes + b0 * u_prev;
    float zhat_dot_3 = -l3 * zhat_1 + l3 * mes;

    //Now update the estimated states:
    zhat_1 += zhat_dot_1 * dt;
    zhat_2 += zhat_dot_2 * dt;
    zhat_3 += zhat_dot_3 * dt;

    //and finally compute the control law:
    float u = (kp * (ref - zhat_1) - kd * zhat_2 - zhat_3) / b0;

    al->u_prev = u;
    al->zhat[0] = zhat_1;
    al->zhat[1] = zhat_2;
    al->zhat[2] = zhat_3;

    *command = u;

    return 0;
}

int adrc_control_law_tune(struct adrc_control_law *al, float dt, float wo, float b0, float kp, float kd)
{
    if(!al)
        return -EINVAL;

    al->interface.reset = reset;
    al->interface.set = set;
    al->interface.update = update;
    al->b0 = b0;
    al->kp = kp;
    al->kd = kd;

    //Compute discrete time observer gains:
    float z_eso = exp(-wo * dt);
    float one_minus_zeso = (1 - z_eso);

    al->l[2] = 1 - (z_eso * z_eso * z_eso);
    al->l[1] = (3.0f /(2 * dt)) * (one_minus_zeso * one_minus_zeso) * (1 + z_eso);
    al->l[0] = (1 / ( dt * dt)) * (one_minus_zeso * one_minus_zeso * one_minus_zeso * one_minus_zeso);

    return (control_law_reset(&al->interface));
}
```

## src/adrc_control_law.h
```c
#ifndef __ADRC_CONTROL_LAW_H
#define __ADRC_CONTROL_LAW_H

#include "control_law.h"

struct adrc_control_law {
    struct siso_control_law interface;
    float b0;
    float kp;
    float kd;
    float l[3];
    float zhat[3];
    float u_prev;
};

static inline struct siso_control_law * get_adrc_control_law_interface(struct adrc_control_law *al)
{
    if(al) {
        return &al->interface;
    }

    return NULL;
}

int adrc_control_law_tune(struct adrc_control_law *al, float dt, float wo, float b0, float kp, float kd);

#endif
```

## src/control_law.h
```c
#ifndef __CONTROL_LAW_H
#define __CONTROL_LAW_H

#include <stddef.h>
#include <errno.h>
#include <math.h>

//Abstract control Law class and methods:
struct siso_control_law {
    int (*reset)(struct siso_control_law * self);
    int (*set)(struct siso_control_law * self, float reference, float measurement);
    int (*update)(struct siso_control_law * self, float dt, float *command);

    float error;
    float measurement;
    float reference;
};

static inline int control_law_reset(struct siso_control_law *cl)
{
    if(!cl)
        return -EINVAL;

    if(cl->reset) {
        return cl->reset(cl);
    }

    return -ENOTSUP;
}

static inline int control_law_set(struct siso_control_law *cl, float reference, float measurement)
{
    if(!cl)
        return -EINVAL;

    if(cl->set) {
        return cl->set(cl, reference, measurement);
    }

    return -ENOTSUP;
}

static inline float control_law_update(struct siso_control_law *cl, float dt, float *command)
{
    if(!cl)
        return -EINVAL;

    if(cl->update) {
        return cl->update(cl, dt, command);
    }

    return -ENOTSUP;
}


//extract derived control law class from this base class:
#define CL_CONTAINER_OF(ptr, type, field)  ((type *)(((char *)(ptr)) - offsetof(type, field)))

#endif
```

## src/lqr_siso_control_law.c
```c
#include "lqr_siso_control_law.h"

static int reset (struct siso_control_law * self)
{
    struct lqr_control_law *ll =
        CL_CONTAINER_OF(self, struct lqr_control_law, interface);

    ll->interface.reference = 0.0f;
    ll->interface.measurement = 0.0f;
    ll->zhat[0] = 0.0f;
    ll->zhat[1] = 0.0f;
    ll->zhat[2] = 0.0f;
    ll->u_prev = 0.0f;
    ll->interface.error = 0.0f;

    return 0;
}

static int set (struct siso_control_law * self, float reference, float measurement)
{
    struct lqr_control_law *ll =
        CL_CONTAINER_OF(self, struct lqr_control_law, interface);

    ll->interface.reference = reference;
    ll->interface.measurement = measurement;

    return 0;
}

static int update (struct siso_control_law * self, float dt, float *command)
{
    struct lqr_control_law *ll =
        CL_CONTAINER_OF(self, struct lqr_control_law, interface);

    if(!command)
        return -EINVAL;

    float ref = ll->interface.reference;
    float mes = ll->interface.measurement;
    float zhat_1 = ll->zhat[0];
    float zhat_2 = ll->zhat[1];
    float zhat_3 = ll->zhat[2];
    float l1 = ll->l[0];
    float l2 = ll->l[1];
    float l3 = ll->l[2];
    float u_prev = ll->u_prev;
    float kx[3] = {ll->kx[0], ll->kx[1], ll->kx[2]};
    float kr = ll->kr;

    //We don't have a full picture of the double integrator
    //state, so observe the dynamics to get them:
    float zhat_dot_1 = -l1 * zhat_1 + zhat_2 + l1 * mes;
    float zhat_dot_2 = -l2 * zhat_1 + zhat_3 + l2 * mes +  u_prev;
    float zhat_dot_3 = -l3 * zhat_1 + l3 * mes;

    zhat_1 += zhat_dot_1 * dt;
    zhat_2 += zhat_dot_2 * dt;
    zhat_3 += zhat_dot_3 * dt;

    //Now compute LQR control law as regular full state
    //feedback control:
    float u = (ref * kr) - (kx[0] * zhat_1 +
                            kx[1] * zhat_2 +
                            kx[2] * zhat_3 );

    ll->u_prev = u;
    ll->zhat[0] = zhat_1;
    ll->zhat[1] = zhat_2;
    ll->zhat[2] = zhat_3;

    *command = u;

    return 0;
}

int lqr_control_law_tune(struct lqr_control_law *ll, float dt, float wo, float kr, float kx[3])
{
    ll->interface.reset = reset;
    ll->interface.set = set;
    ll->interface.update = update;

    ll->kr = kr;
    ll->kx[0] = kx[0];
    ll->kx[1] = kx[1];
    ll->kx[2] = kx[2];

    //Compute discrete time observer gains:
    float z_eso = exp(-wo * dt);
    float one_minus_zeso = (1 - z_eso);

    ll->l[2] = 1 - (z_eso * z_eso * z_eso);
    ll->l[1] = (3.0f /(2 * dt)) * (one_minus_zeso * one_minus_zeso) * (1 + z_eso);
    ll->l[0] = (1 / ( dt * dt)) * (one_minus_zeso * one_minus_zeso * one_minus_zeso * one_minus_zeso);

    return (control_law_reset(&ll->interface));
}
```

## src/lqr_siso_control_law.h
```c
#ifndef __LQR_SISO_CONTROL_LAW_H
#define __LQR_SISO_CONTROL_LAW_H

#include "control_law.h"

struct lqr_control_law {
    struct siso_control_law interface;
    float kr;
    float kx[3];
    float l[3];
    float zhat[3];
    float u_prev;
};

static inline struct siso_control_law * get_lqr_control_law_interface(struct lqr_control_law *ll)
{
    if(ll) {
        return &ll->interface;
    }

    return NULL;
}

int lqr_control_law_tune(struct lqr_control_law *ll, float dt, float wo, float kr, float kx[3]);

#endif
```

## src/motor_control_pipeline.c
```c
#include <zephyr/kernel.h>
#include <zephyr/device.h>
#include <zephyr/init.h>
#include <zephyr/drivers/counter.h>
#include "motor_control_pipeline.h"

#define CONTROL_PIPELINE_US_PERIOD (500)

static struct motor_control_pipeline* pipeline;
static float now_seconds = 0.0f;
static const struct device *timer_dev = DEVICE_DT_GET( DT_INST(0,st_stm32_counter));
static struct counter_alarm_cfg alarm_cfg;

static void motor_control_work_handler(struct k_work *work)
{
    uint32_t now_ticks;
    counter_get_value(timer_dev, &now_ticks);
    now_seconds = (float)(counter_ticks_to_us(timer_dev, now_ticks)) * 1e-6;

    if(pipeline) {
        float last_time = pipeline->last_time;
        float target_position = pipeline->target_position;
        float current_position;
        float control_effort;
        int ticks = pipeline->ticks;
        int sample_ratio = pipeline->sample_ratio;
        int err, werr;

        ticks++;
        if(ticks == sample_ratio) {
            ticks = 0;
            float dt = fabs(now_seconds - last_time);

            err = motor_hardware_get_angle(pipeline->hw, &current_position);

            if(pipeline->position_cl) {
                control_law_set(pipeline->position_cl, target_position, current_position);
                control_law_update(pipeline->position_cl, dt, &control_effort);
            } else {
                control_effort = target_position;
            }

            werr = motor_hardware_set_speed(pipeline->hw, control_effort);

            pipeline->control_effort = control_effort;
            pipeline->current_position = current_position;
            pipeline->last_time = now_seconds;
            pipeline->dt = dt;
            pipeline->reading_error = err;
            pipeline->writing_error = werr;
        }
        pipeline->ticks = ticks;
    }
}

K_WORK_DEFINE(motor_work, motor_control_work_handler);

static void timer_interrupt_fn(const struct device *counter_dev,
                            uint8_t chan_id, uint32_t ticks,
                            void *user_data)
{
    k_work_submit(&motor_work);
    counter_set_channel_alarm(timer_dev, 0, &alarm_cfg);
}

static int motor_control_pipeline_init_backend(void)
{
    counter_start(timer_dev);
    alarm_cfg.flags = 0;
    alarm_cfg.ticks = counter_us_to_ticks(timer_dev, CONTROL_PIPELINE_US_PERIOD);
    alarm_cfg.callback = timer_interrupt_fn;
    alarm_cfg.user_data = &alarm_cfg;
    counter_set_channel_alarm(timer_dev, 0, &alarm_cfg);

    return 0;
}

SYS_INIT(motor_control_pipeline_init_backend, POST_KERNEL, CONFIG_APPLICATION_INIT_PRIORITY);

int motor_control_pipeline_add_hw(struct motor_control_pipeline* cp, struct motor_hardware_if *hw)
{
    if(!cp || !hw)
        return -EINVAL;

    cp->hw = hw;

    return 0;
}

int motor_control_pipeline_add_control(struct motor_control_pipeline* cp, struct siso_control_law *cl)
{
    if(!cp)
        return -EINVAL;

    cp->position_cl = cl;

    return 0;
}

int motor_control_pipeline_remove_control(struct motor_control_pipeline* cp)
{
    if(!cp)
        return -EINVAL;

    cp = NULL;

    return 0;
}

int motor_control_pipeline_register(struct motor_control_pipeline* cp, int sample_ratio)
{
    if(!cp)
        return -EINVAL;

    if(!cp->hw)
        return -ENODEV;

    if(!sample_ratio)
        return -EINVAL;

    cp->sample_ratio = sample_ratio;
    cp->ticks = 0;
    cp->last_time = 0.0f;

    pipeline = cp;

    return 0;
}

int motor_control_pipeline_set_position(struct motor_control_pipeline* cp, float target_position)
{
    if(!cp)
        return -EINVAL;

    cp->target_position = target_position;

    return 0;
}
```

## src/motor_control_pipeline.h
```c
#ifndef __MOTOR_CONTROL_PIPELINE_H
#define __MOTOR_CONTROL_PIPELINE_H

#include <stdbool.h>
#include "motor_hardware.h"
#include "control_law.h"

struct motor_control_pipeline {
    struct motor_hardware_if *hw;
    struct siso_control_law *position_cl;
    float  last_time;
    float dt;
    float target_position;
    float current_position;
    float control_effort;
    int ticks;
    int sample_ratio;
    int reading_error;
    int writing_error;
};

int motor_control_pipeline_add_hw(struct motor_control_pipeline* cp, struct motor_hardware_if *hw);
int motor_control_pipeline_add_control(struct motor_control_pipeline* cp, struct siso_control_law *cl);
int motor_control_pipeline_remove_control(struct motor_control_pipeline* cp);
int motor_control_pipeline_set_position(struct motor_control_pipeline* cp, float target_position);
int motor_control_pipeline_register(struct motor_control_pipeline* cp, int sample_ratio);

#endif
```

## src/motor_hardware.h
```c
#ifndef __MOTOR_HARDWARE_H
#define __MOTOR_HARDWARE_H

#include <stddef.h>
#include <errno.h>
#include <math.h>

struct motor_hardware_if {
    int (*reset) (struct motor_hardware_if *self);
    int (*set_current) (struct motor_hardware_if *self, float current);
    int (*set_voltage) (struct motor_hardware_if *self, float voltage);
    int (*set_speed) (struct motor_hardware_if *self, float speed);
    int (*get_angle)(struct motor_hardware_if *self, float *degrees);
};

static inline int motor_hardware_reset(struct motor_hardware_if *mh)
{
    if(!mh)
        return -EINVAL;

    if(mh->reset) {
        return mh->reset(mh);
    }

    return -ENOTSUP;
}

static inline int motor_hardware_set_speed(struct motor_hardware_if *mh, float speed)
{
    if(!mh)
        return -EINVAL;

    if(mh->set_speed) {
        return mh->set_speed(mh, speed);
    }

    return -ENOTSUP;
}

static inline int motor_hardware_set_current(struct motor_hardware_if *mh, float current)
{
    if(!mh)
        return -EINVAL;

    if(mh->set_current) {
        return mh->set_current(mh, current);
    }

    return -ENOTSUP;
}

static inline int motor_hardware_set_voltage(struct motor_hardware_if *mh, float voltage)
{
    if(!mh)
        return -EINVAL;

    if(mh->set_voltage) {
        return mh->set_voltage(mh, voltage);
    }

    return -ENOTSUP;
}

static inline float motor_hardware_get_angle(struct motor_hardware_if *mh, float *angle)
{
    if(!mh)
        return -EINVAL;

    if(mh->get_angle) {
        return mh->get_angle(mh, angle);
    }

    return -ENOTSUP;
}

//extract derived motor hw class from this base class:
#define MH_CONTAINER_OF(ptr, type, field)  ((type *)(((char *)(ptr)) - offsetof(type, field)))

#endif
```

## src/motor_hardware_mf4005.c
```c
#include <zephyr/sys/printk.h>
#include "motor_hardware_mf4005.h"

#define MF4005_CAN_DEVID        0x141
#define MF4005_SET_CURRENT_CMD  0xA1
#define MF4005_SET_SPEED_CMD    0xA2
#define MF4005_TURN_OFF_CMD     0x80
#define MF4005_TURN_ON_CMD      0x88

CAN_MSGQ_DEFINE(mh_can_msgq, 2);

const float mh_max_current_amperes = 2.8f;
const float mh_max_speed_dps = 14000.0f;
const float mh_encoder_to_degrees = (360.0f / 65536.0f); //MF4005 encoder is 16bit
const float mh_current_to_raw = (32.0f / 0.240f); //MF4005 max current is 240 mA
const float mh_speed_to_raw = 100.0f;

static const struct can_filter motor_filter = {
    .flags = CAN_FILTER_DATA,
    .id = MF4005_CAN_DEVID,
    .mask = CAN_STD_ID_MASK
};

static int reset (struct motor_hardware_if *self)
{
    struct motor_hardware_mf4005 *mh =
        MH_CONTAINER_OF(self, struct motor_hardware_mf4005, interface);

    struct can_frame tx_frame = {
        .flags = 0,
        .id = MF4005_CAN_DEVID,
        .dlc = 8,
        .data[0] = MF4005_TURN_OFF_CMD
	};

    struct can_frame rx_frame = {
        .flags = 0,
        .id = MF4005_CAN_DEVID,
        .dlc = 8
    };

    can_start(mh->can_port);
    can_add_rx_filter_msgq(mh->can_port, &mh_can_msgq, &motor_filter);

    int err = can_send(mh->can_port, &tx_frame, K_MSEC(100), NULL, NULL);
    if(err)
        return err;

    err = k_msgq_get(&mh_can_msgq, &rx_frame, K_MSEC(100));
    if(err)
        return err;

    tx_frame.data[0] = MF4005_TURN_ON_CMD;

    can_send(mh->can_port, &tx_frame, K_MSEC(100), NULL, NULL);
    if(err)
        return err;

    err = k_msgq_get(&mh_can_msgq, &rx_frame, K_MSEC(100));
        return err;

    return motor_hardware_set_speed(self, 0.0f);
}

static int set_speed (struct motor_hardware_if *self, float speed)
{
    struct motor_hardware_mf4005 *mh =
        MH_CONTAINER_OF(self, struct motor_hardware_mf4005, interface);

    struct can_frame tx_frame = {
        .flags = 0,
        .id = MF4005_CAN_DEVID,
        .dlc = 8
    };

    if(speed > mh_max_speed_dps) {
        speed = mh_max_speed_dps;
    } else if (speed < -mh_max_speed_dps) {
        speed = -mh_max_speed_dps;
    }

    int32_t command = (int32_t)(speed * mh_speed_to_raw);

    tx_frame.data[0] = MF4005_SET_SPEED_CMD;
    tx_frame.data[4] = (uint8_t)(command & 0xFF);
    tx_frame.data[5] = (uint8_t)((command >> 8)  & 0xFF);
    tx_frame.data[6] = (uint8_t)((command >> 16) & 0xFF);
    tx_frame.data[7] = (uint8_t)((command >> 24) & 0xFF);

    int err = can_send(mh->can_port, &tx_frame, K_NO_WAIT, NULL, NULL);
    if(err)
        return err;

    return 0;
}

static int get_angle(struct motor_hardware_if *self, float *degrees)
{
    struct motor_hardware_mf4005 *mh =
        MH_CONTAINER_OF(self, struct motor_hardware_mf4005, interface);

    struct can_frame rx_frame = {
        .flags = 0,
        .id = MF4005_CAN_DEVID,
        .dlc = 8
    };

    if(!degrees) {
        return -EINVAL;
    }

    int err = k_msgq_get(&mh_can_msgq, &rx_frame, K_NO_WAIT);
    if(!err) {
        uint16_t raw_angle = rx_frame.data[7];
        raw_angle <<= 8;
        raw_angle |= rx_frame.data[6];

        mh->current_angle_deg = (float )(raw_angle) * mh_encoder_to_degrees;
    }

    *degrees = mh->current_angle_deg;
    return err;
}

int motor_hardware_mf4005_init(struct motor_hardware_mf4005 *mh, const struct device *can_port)
{
    if(!can_port)
        return -EINVAL;

    mh->can_port = can_port;
    mh->interface.reset = reset;
    mh->interface.set_speed = set_speed;
    mh->interface.get_angle = get_angle;

    return motor_hardware_reset(&mh->interface);
}
```

## src/motor_hardware_mf4005.h
```c
#ifndef __MOTOR_HARDWARE_MF4005_H
#define __MOTOR_HARDWARE_MF4005_H

#include <zephyr/kernel.h>
#include <zephyr/device.h>
#include <zephyr/drivers/can.h>
#include "motor_hardware.h"

struct motor_hardware_mf4005 {
    struct motor_hardware_if interface;
    const struct device *can_port;
    float current_angle_deg;
};

static inline
struct motor_hardware_if * motor_hardware_mf4005_get_if(struct motor_hardware_mf4005 *mh)
{
    if(mh) {
        return &mh->interface;
    }

    return NULL;
}

int motor_hardware_mf4005_init(struct motor_hardware_mf4005 *mh, const struct device *can_port);

#endif
```

## src/pid_control_law.c
```c
#include "pid_control_law.h"

static int reset (struct siso_control_law * self)
{
    struct pid_control_law *pl =
        CL_CONTAINER_OF(self, struct pid_control_law, interface);

    pl->integrator = 0.0f;
    pl->prev_error = 0.0f;
    pl->interface.reference = 0.0f;
    pl->interface.measurement = 0.0f;

    return 0;
}

static int set (struct siso_control_law * self, float reference, float measurement)
{
    struct pid_control_law *pl =
        CL_CONTAINER_OF(self, struct pid_control_law, interface);

    pl->interface.reference = reference;
    pl->interface.measurement = measurement;
    return 0;
}

static int update (struct siso_control_law * self, float dt, float *command)
{
    (void)dt;

    struct pid_control_law *pl =
        CL_CONTAINER_OF(self, struct pid_control_law, interface);

    if(!command)
        return -EINVAL;

    float ref = pl->interface.reference;
    float mes = pl->interface.measurement;
    float kp = pl->kp;
    float ki = pl->ki;
    float kd = pl->kd;
    float integrator = pl->integrator;
    float prev_error = pl->prev_error;
    float max_integrator = pl->max_integrator;

    float error = ref - mes;
    float error_derivative = error - prev_error;

    integrator += error;
    if(integrator > max_integrator) {
        integrator = max_integrator;
    } else if ( integrator < -max_integrator) {
        integrator = -max_integrator;
    }

    float u = (kp * error) + (ki * integrator) + (kd * error_derivative);

    prev_error = error;

    pl->integrator = integrator;
    pl->prev_error = prev_error;
    pl->max_integrator = max_integrator;
    *command = u;

    return 0;
}

int pid_control_law_tune(struct pid_control_law *pl, float kp, float ki, float kd, float max_integrator)
{
    if(!pl)
        return -EINVAL;

    pl->interface.reset = reset;
    pl->interface.set = set;
    pl->interface.update = update;

    pl->kp = kp;
    pl->ki = ki;
    pl->kd = kd;
    pl->max_integrator = max_integrator;

    return (control_law_reset(&pl->interface));
}
```

## src/pid_control_law.h
```c
#ifndef __PID_CONTROL_LAW_H
#define __PID_CONTROL_LAW_H

#include "control_law.h"

struct pid_control_law {
    struct siso_control_law interface;
    float kp;
    float ki;
    float kd;
    float integrator;
    float prev_error;
    float max_integrator;
};

static inline struct siso_control_law * get_pid_control_law_interface(struct pid_control_law  *pl)
{
    if(pl) {
        return &pl->interface;
    }

    return NULL;
}

int pid_control_law_tune(struct pid_control_law *pl, float kp, float ki, float kd, float max_integrator);

#endif
```
